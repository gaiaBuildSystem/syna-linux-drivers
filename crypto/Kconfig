## crypto/Kconfig
```kconfig
# SPDX-License-Identifier: GPL-2.0-only
#
#

menuconfig SYNAPTICS_CRYPTO
	bool "Synaptics hardware crypto driver support"
	default y
	help
	  Synaptics crypto driver support

if SYNAPTICS_CRYPTO

config BERLIN_M2M
	tristate "Support BERLIN M2M CRYPTO"
	default n
	depends on BERLIN_BM
	depends on BERLIN_TSP
	help
	  Enable support for berlin HW CRYPTO


config SYNAPTICS_CRYPTO_TEE
	tristate "Synaptics OP-TEE Crypto Support"
	depends on OPTEE
	default n
	help
	  This enables the custom AES-GCM hardware key API (aes_hwkey_gcm_*)
	  It routes the cryptography requests securely to the OP-TEE Trusted
	  Application via SMC.

endif
```

## gpu/Kconfig
```kconfig
# SPDX-License-Identifier: GPL-2.0
#
# Synaptics driver config
#

menu "Synaptics GPU drivers"

source "drivers/synaptics/gpu/arm/mali/Kconfig"

source "drivers/synaptics/gpu/arm/mali-midgard/Kconfig"

source "drivers/synaptics/gpu/vivante/Kconfig"

endmenu
```

## input/touchscreen/Kconfig
```kconfig
# SPDX-License-Identifier: GPL-2.0-only
#
# Touchscreen driver configuration
#

config TOUCHSCREEN_FT7421
	tristate "FT7421 I2C touchscreen"
	depends on I2C && OF
	help
	  Say Y here to enable support for the Focaltech FT7421 touch panel

config TOUCHSCREEN_FT5X06
	tristate "FT5X06 I2C touchscreen"
	depends on I2C && OF
	help
	  Say Y here to enable support for the Focaltech FT5X06 touch panel

config TOUCHSCREEN_DVF9A
	tristate "DVF9A based touchscreens"
	depends on MFD_DSPG_DVF9A
	help
	Say Y here if you have a DVF9A acting as a touchscreen
	controller.

	If unsure, say N.

config TOUCHSCREEN_GOODIX_TS
	tristate "Goodix I2C touchscreen"
	depends on I2C
	depends on GPIOLIB || COMPILE_TEST
	help
	  Say Y here if you have the Goodix touchscreen (such as one
	  installed in Onda v975w tablets) connected to your
	  system. It also supports 5-finger chip models, which can be
	  found on ARM tablets, like Wexler TAB7200 and MSI Primo73.

	  If unsure, say N.

	  To compile this driver as a module, choose M here: the
	  module will be called goodix.
```

## net/mdio/Kconfig
```kconfig
# SPDX-License-Identifier: GPL-2.0-only
#
# PHY Layer Configuration
#

config MDIO_BUS_DEMUX
	tristate "MDIO BUS DEMUX"
	select MULTIPLEXER
	help
	  Supports the MDIO BUX DEMUX.
```

## npu/Kconfig
```kconfig
menuconfig SYNAPTICS_NPU
	default y
	bool "Enable the Synaptics NPU driver features"
	help
	  This option enables support for the Synaptics Neural Processing Unit (NPU)

	  If unsure, say Y.

if SYNAPTICS_NPU

config SYNAPTICS_VIS_NPU
	tristate "Enable SyNAP VIS NPU support"
  default m
	help
	  This option enables support for the Synaptics Vision
	  Neural Processing Unit (NPU).

endif # SYNAPTICS_NPU
```

## soc/berlin/Kconfig.isp
```kconfig
#
# ISP variants
#

config SYNA_ISP
	default n
	tristate "Synaptics ISP Support"
	select VIDEO_V4L2
	select VIDEOBUF2_CORE
	select VIDEOBUF2_MEMOPS
	select VIDEOBUF2_DMA_CONTIG
	help
	  Enable support for Synaptics ISP...
```
