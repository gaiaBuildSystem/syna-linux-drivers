## net/wireless/Kconfig
```kconfig
# SPDX-License-Identifier: GPL-2.0-only
#
# Wireless LAN device configuration
#

source "drivers/synaptics/net/wireless/bcmdhd/Kconfig"
```

## regulator/Kconfig
```kconfig
# SPDX-License-Identifier: GPL-2.0-only
menuconfig SYNAPTICS_REGULATOR
  bool "Synaptics regulator driver support"
  default y
  help
    Synaptics regulator driver support

if SYNAPTICS_REGULATOR

config REGULATOR_HL7593
	tristate "Halo HL7593 regulator"
	depends on I2C && (OF || COMPILE_TEST)
	select REGMAP_I2C
	help
	  This driver supports HL7593 single output regulator.

config REGULATOR_MP886X
	tristate "MPS MP8869 regulator driver"
	depends on I2C && (OF || COMPILE_TEST)
	select REGMAP_I2C
	help
	  This driver supports the MP8869 voltage regulator.

config REGULATOR_RT5739
	tristate "Richtek RT5739 Regulator"
	depends on I2C && OF
	select REGMAP_I2C
	help
	  This driver supports RT5739 voltage regulator chip

config REGULATOR_SY8824X
	tristate "Silergy SY8824C/SY8824E regulator"
	depends on I2C && (OF || COMPILE_TEST)
	select REGMAP_I2C
	help
	  This driver supports SY8824C single output regulator.

config REGULATOR_SY8827N
	tristate "Silergy SY8827N regulator"
	depends on I2C && (OF || COMPILE_TEST)
	select REGMAP_I2C
	help
	  This driver supports SY8827N single output regulator.

config REGULATOR_DVF9A
	tristate "DSPG-DVF9A PMU"
	depends on MFD_DSPG_DVF9A
	help
	  This driver provides support for the voltage regulators on the
	  DSPG-DVF9A PMU.

config REGULATOR_DVFA10_LDO_DSI
	tristate "DSPG-DVFA10 LDO DSI"
	depends on MFD_DSPG_DVF9A
	help
	  This driver provides support for the LDO DSI voltage regulator
	  on the DSPG-DVFA10 PMU.

config REGULATOR_RPI_PANEL_ATTINY
	tristate "ATtiny RPI Panel Regulator"
	depends on I2C && (OF || COMPILE_TEST)
	select REGMAP_I2C
	help
	  This driver provides support for the ATtiny RPI panel regulator.

endif
```
